## config/west.yml
```yaml
manifest:
  remotes:
    - name: zmkfirmware
      url-base: https://github.com/zmkfirmware
  projects:
    - name: zmk
      remote: zmkfirmware
      revision: v0.3  # Keeps you on the stable 2025/2026 release
      import: app/west.yml
  self:
    path: config
```
